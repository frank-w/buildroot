## configs/BPI-R2_defconfig
```kconfig
#BR2_aarch64=y
#BR2_cortex_a53=y

BR2_arm=y
BR2_cortex_a7=y
#BR2_ARM_FPU_VFPV4=y

BR2_TARGET_ROOTFS_CPIO=y
BR2_TARGET_ROOTFS_CPIO_GZIP=y
#use serial console by default
BR2_TARGET_GENERIC_GETTY_PORT=ttyS0

BR2_KERNEL_HEADERS_5_4=y #(for iproute2)
BR2_TOOLCHAIN_BUILDROOT_WCHAR=y #(for nano)
BR2_PACKAGE_OPENSSH=y
BR2_PACKAGE_NETSTAT_NAT=y
BR2_PACKAGE_BRIDGE_UTILS=y
BR2_PACKAGE_ETHTOOL=y
BR2_PACKAGE_IPERF3=y
BR2_PACKAGE_IPROUTE2=y
BR2_PACKAGE_IPUTILS=y
BR2_PACKAGE_TCPDUMP=y
BR2_PACKAGE_MC=y
BR2_PACKAGE_NANO=y
BR2_PACKAGE_USBUTILS=y
BR2_PACKAGE_PCIUTILS=y

BR2_PACKAGE_DOSFSTOOLS=y
#BR2_PACKAGE_DOSFSTOOLS_MKDOSFS=y
BR2_PACKAGE_DOSFSTOOLS_MKFS_FAT=y

BR2_TARGET_ROOTFS_EXT2=y
BR2_TARGET_ROOTFS_EXT2_MKFS_OPTIONS=y

BR2_TOOLCHAIN_BUILDROOT_CXX=y
BR2_PACKAGE_GPTFDISK=y
BR2_PACKAGE_PARTED=y

BR2_PACKAGE_MMC_UTILS
```
